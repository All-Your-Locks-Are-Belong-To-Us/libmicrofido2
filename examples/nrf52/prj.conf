## CMakeLists.txt
```
#######################################
# General
cmake_minimum_required(VERSION 3.20.0)

find_package(Zephyr REQUIRED HINTS $ENV{ZEPHYR_BASE})
project(nrf52-libmicrofido C)

if (CONFIG_NRF_SECURITY STREQUAL "y")
  add_compile_definitions(USE_HW_CRYPTO=1)
  set(additional_libmicrofido2_cmake_flags
    "-DENABLE_SOFTWARE_CRYPTO=OFF"
  )
endif()

include_directories(${CMAKE_CURRENT_SOURCE_DIR})
target_sources(app PRIVATE
  src/main.c
  clock/clock_cycles.c
  hw_crypto/hw_crypto.c
  stateless_rp/stateless_rp.c
  stateless_rp/stateless_rp_nfc_simulator.c
)

#######################################
# libmicrofido2

# Necessary for building libmicrofido2
include(ExternalProject)

# Extract the Zephyr compilation settings.
zephyr_get_include_directories_for_lang_as_string(       C includes)
zephyr_get_system_include_directories_for_lang_as_string(C system_includes)
zephyr_get_compile_definitions_for_lang_as_string(       C definitions)
zephyr_get_compile_options_for_lang_as_string(           C options)

set(external_project_cflags
  "${includes} ${definitions} ${options} ${system_includes} --specs=nosys.specs"
)

# Directory settings.
set(libmicrofido2_src_dir   ${CMAKE_CURRENT_SOURCE_DIR}/../../)
set(libmicrofido2_build_dir ${CMAKE_CURRENT_BINARY_DIR}/libmicrofido2)

set(LIBMICROFIDO2_LIB_DIR     ${libmicrofido2_build_dir})
set(LIBMICROFIDO2_INCLUDE_DIR ${libmicrofido2_src_dir}/include)

ExternalProject_Add(
  libmicrofido2_project   # Name for custom target
  PREFIX                  ${libmicrofido2_build_dir} # Root directory for the lib.
  SOURCE_DIR              ${libmicrofido2_src_dir}
  BINARY_DIR              ${libmicrofido2_build_dir}
  CMAKE_ARGS              # Pass the necessary build flags.
  -DCMAKE_C_FLAGS=${external_project_cflags}
  -DCMAKE_C_COMPILER=${CMAKE_C_COMPILER}
  -DCMAKE_AR=${CMAKE_AR}
  -DCMAKE_BUILD_TYPE=${CMAKE_BUILD_TYPE}
  -DZEPHYR=1
  ${additional_libmicrofido2_cmake_flags}
  INSTALL_COMMAND         "" # No installation necessary, just build it.
  BUILD_BYPRODUCTS        ${LIBMICROFIDO2_LIB_DIR}/libmicrofido2.a
)

# Create a wrapper CMake library that our app can link with.
add_library(libmicrofido2_lib STATIC IMPORTED GLOBAL)
add_dependencies(
  libmicrofido2_lib
  libmicrofido2_project
)
set_target_properties(libmicrofido2_lib PROPERTIES IMPORTED_LOCATION             ${LIBMICROFIDO2_LIB_DIR}/libmicrofido2.a)
file(MAKE_DIRECTORY ${LIBMICROFIDO2_INCLUDE_DIR}) # Hack to make the line below work on the first download.
set_target_properties(libmicrofido2_lib PROPERTIES INTERFACE_INCLUDE_DIRECTORIES ${LIBMICROFIDO2_INCLUDE_DIR})

# Link with libmicrofido2
target_link_libraries(app PUBLIC libmicrofido2_lib)
```

## prj.conf
```kconfig
# Enable logging module.
CONFIG_LOG=y
CONFIG_LOG_BACKEND_UART=y
# Instead of restarting, print log and hang.
CONFIG_RESET_ON_FATAL_ERROR=n
# Add enough stack for allocated buffers.
CONFIG_MAIN_STACK_SIZE=16384
# We use some special features from newlib.
CONFIG_NEWLIB_LIBC=y

# Enable PSA Hardware Crypto
CONFIG_NRF_SECURITY=y

# Enable timing functions (counting clock cycles).
CONFIG_TIMING_FUNCTIONS=y

# Enable Stack Painting (initialize with 0xaa)
CONFIG_INIT_STACKS=y
```

## src/main.c
```c
/*
 * Copyright (c) 2022 Felix Gohla, Konrad Hanff, Tobias Kantusch,
 *                    Quentin Kuth, Felix Roth. All rights reserved.
 *
 * Use of this source code is governed by a BSD-style
 * license that can be found in the LICENSE file.
 */

#include <zephyr/zephyr.h>
#include <assert.h>
#include <stdio.h>
#include <string.h>

#include <fido.h>

#include "clock/clock_cycles.h"
#include "hw_crypto/hw_crypto.h"
#include "stateless_rp/stateless_rp_nfc_simulator.h"
#include "stateless_rp/stateless_rp.h"


int main(void) {
    clock_init();
    if (init_hw_crypto() != 0) {
        return -1;
    } else {
        printk("Initialized cryptography.\n");
    }

    fido_dev_t dev;
    if (prepare_stateless_rp_nfc_simulator_device(&dev) != 0) {
        printk("Could not setup simulator device.\n");
        return -1;
    }
    const uint8_t updater_public_key[] = {0xA8, 0xEE, 0x4D, 0x2B, 0xD5, 0xAE, 0x09, 0x0A, 0xBC, 0xA9, 0x8A, 0x06, 0x6C, 0xA5, 0xB3, 0xA6, 0x22, 0x84, 0x89, 0xF5, 0x9E, 0x30, 0x90, 0x87, 0x65, 0x62, 0xB9, 0x79, 0x8A, 0xE7, 0x05, 0x15};
    clock_start_counting();
    const int ret = stateless_assert(&dev, "example.com", updater_public_key);
    uint64_t elapsed_cycles = clock_stop_counting();
    printk("Elapsed cycles for stateless assertion: %zu\n", elapsed_cycles);
    return ret;
}
```

## src/clock_cycles.c
```c
/*
 * Copyright (c) 2022 Felix Gohla, Konrad Hanff, Tobias Kantusch,
 *                    Quentin Kuth, Felix Roth. All rights reserved.
 *
 * Use of this source code is governed by a BSD-style
 * license that can be found in the LICENSE file.
 */

#include <zephyr/timing/timing.h>

// Buffer variable used for measuring elapsed clock cycles.
timing_t clock_cycle_start;
```

## src/clock_cycles.h
```c
/*
 * Copyright (c) 2022 Felix Gohla, Konrad Hanff, Tobias Kantusch,
 *                    Quentin Kuth, Felix Roth. All rights reserved.
 *
 * Use of this source code is governed by a BSD-style
 * license that can be found in the LICENSE file.
 */

#pragma once

#include <stdint.h>
#include <zephyr/kernel.h>
#include <zephyr/sys/arch_interface.h>


extern volatile timing_t clock_cycle_start;

inline void clock_init() {
    arch_timing_init();
}

/**
 * @brief Starts counting clock cycles.
 * 
 */
static inline void clock_start_counting() {
    arch_timing_start();
    clock_cycle_start = arch_timing_counter_get();
}

/**
 * @brief Stops counting clock cycles and returns the number of elapsed cycles.
 * 
 */
static inline uint64_t clock_stop_counting() {
    timing_t end = arch_timing_counter_get();
    uint64_t val = arch_timing_cycles_get(&clock_cycle_start, &end);
    arch_timing_stop();
    return val;
}

/**
 * @brief Converts clock cycles to nanoseconds.
 * 
 * @param cycles The number of cycles.
 * @return uint64_t The number of nanoseconds.
 */
static inline uint64_t clock_cyles_to_ns(uint64_t cycles) {
    return arch_timing_cycles_to_ns(cycles);
}
```

## src/hw_crypto.c
```c
/*
 * Copyright (c) 2022 Felix Gohla, Konrad Hanff, Tobias Kantusch,
 *                    Quentin Kuth, Felix Roth. All rights reserved.
 *
 * Use of this source code is governed by a BSD-style
 * license that can be found in the LICENSE file.
 */

#include <zephyr/zephyr.h>
#include <assert.h>
#include <stdio.h>
#include <string.h>

#ifdef USE_HW_CRYPTO
#include <psa/crypto.h>
#endif

#include <fido.h>

#ifdef USE_HW_CRYPTO

void sha256(const uint8_t *data, size_t data_len, uint8_t *hash) {
    size_t olen; // We actually do not do anything with this parameter, but the API requires it.
    psa_status_t status = psa_hash_compute(
        PSA_ALG_SHA_256,
        data,
        data_len,
        hash,
        PSA_HASH_LENGTH(PSA_ALG_SHA_256),
        &olen
    );
    assert(status == PSA_SUCCESS);
}

void sha512(const uint8_t *data, size_t data_len, uint8_t *hash) {
    size_t olen; // We actually do not do anything with this parameter, but the API requires it.
    psa_status_t status = psa_hash_compute(
        PSA_ALG_SHA_512,
        data,
        data_len,
        hash,
        PSA_HASH_LENGTH(PSA_ALG_SHA_512),
        &olen
    );
    assert(status == PSA_SUCCESS);
}

int aes_gcm_encrypt(
    const uint8_t *key, size_t key_len,
    const uint8_t *iv, size_t iv_len,
    const uint8_t *plaintext, size_t plaintext_len,
    const uint8_t *aad, size_t aad_len,
    uint8_t *ciphertext, uint8_t *tag
) {
    psa_status_t status;
    int ret;
    const size_t tag_len = PSA_AEAD_TAG_LENGTH(PSA_KEY_TYPE_AES, key_len * 8, PSA_ALG_GCM);
    uint8_t cipher_buf[plaintext_len + tag_len];
    size_t cipher_size;


    // Import the key.
    psa_key_attributes_t key_attributes = PSA_KEY_ATTRIBUTES_INIT;

    psa_set_key_usage_flags(&key_attributes, PSA_KEY_USAGE_ENCRYPT);
    psa_set_key_lifetime(&key_attributes, PSA_KEY_LIFETIME_VOLATILE);
    psa_set_key_algorithm(&key_attributes, PSA_ALG_GCM);
    psa_set_key_type(&key_attributes, PSA_KEY_TYPE_AES);
    psa_set_key_bits(&key_attributes, key_len * 8);

    psa_key_handle_t key_handle;
    
    status = psa_import_key(&key_attributes, key, key_len, &key_handle);
    if (status != PSA_SUCCESS) {
        printk("psa_import_key failed! (Error: %d)\n", status);
        ret = -1;
        goto out;
    }

    status = psa_aead_encrypt(
        key_handle,
        PSA_ALG_GCM,
        iv,
        iv_len,
        aad,
        aad_len,
        plaintext,
        plaintext_len,
        cipher_buf,
        sizeof(cipher_buf),
        &cipher_size
    );
    if (status != PSA_SUCCESS) {
        printk("psa_aead_encrypt failed! (Error: %d)\n", status);
        ret = -1;
        goto out;
    }
    assert(cipher_size == plaintext_len + tag_len);

    memcpy(ciphertext, cipher_buf, plaintext_len);
    memcpy(tag, cipher_buf + plaintext_len, tag_len);
    ret = 0;
out:
    memset(cipher_buf, 0, sizeof(cipher_buf));
    psa_reset_key_attributes(&key_attributes);
    status = psa_destroy_key(key_handle);
    if (status != PSA_SUCCESS) {
        printk("psa_destroy_key failed! (Error: %d)\n", status);
        ret = -1;
    }
    return ret;
}

int aes_gcm_decrypt(
    const uint8_t *key, size_t key_len,
    const uint8_t *iv, size_t iv_len,
    const uint8_t *ciphertext, size_t ciphertext_len,
    const uint8_t *aad, size_t aad_len,
    const uint8_t *tag,
    uint8_t *plaintext
) {
    psa_status_t status;
    int ret;
    const size_t tag_len = PSA_AEAD_TAG_LENGTH(PSA_KEY_TYPE_AES, key_len * 8, PSA_ALG_GCM);
    const size_t ciphertext_buf_len = ciphertext_len + tag_len;
    uint8_t ciphertext_buf[ciphertext_buf_len];
    uint8_t plaintext_buf[ciphertext_len];
    size_t decrypted_plaintext_size;

    // Import the key.
    psa_key_attributes_t key_attributes = PSA_KEY_ATTRIBUTES_INIT;

    psa_set_key_usage_flags(&key_attributes, PSA_KEY_USAGE_DECRYPT);
    psa_set_key_lifetime(&key_attributes, PSA_KEY_LIFETIME_VOLATILE);
    psa_set_key_algorithm(&key_attributes, PSA_ALG_GCM);
    psa_set_key_type(&key_attributes, PSA_KEY_TYPE_AES);
    psa_set_key_bits(&key_attributes, key_len * 8);

    psa_key_handle_t key_handle;
    
    status = psa_import_key(&key_attributes, key, key_len, &key_handle);
    if (status != PSA_SUCCESS) {
        printk("psa_import_key failed! (Error: %d)\n", status);
        ret = -1;
        goto out;
    }

    memcpy(ciphertext_buf, ciphertext, ciphertext_len);
    memcpy(ciphertext_buf + ciphertext_len, tag, tag_len);

    status = psa_aead_decrypt(
        key_handle,
        PSA_ALG_GCM,
        iv,
        iv_len,
        aad,
        aad_len,
        ciphertext_buf,
        ciphertext_buf_len,
        plaintext_buf,
        sizeof(plaintext_buf),
        &decrypted_plaintext_size
    );
    if (status != PSA_SUCCESS) {
        printk("psa_aead_encrypt failed! (Error: %d)\n", status);
        ret = -1;
        goto out;
    }

    if (decrypted_plaintext_size != ciphertext_len) {
        printk("Invalid plaintext length detected.\n");
        ret = -1;
        goto out;
    }

    memcpy(plaintext, plaintext_buf, decrypted_plaintext_size);
    ret = 0;
out:
    memset(plaintext_buf, 0, decrypted_plaintext_size);
    memset(ciphertext_buf, 0, ciphertext_buf_len);
    psa_reset_key_attributes(&key_attributes);
    status = psa_destroy_key(key_handle);
    if (status != PSA_SUCCESS) {
        printk("psa_destroy_key failed! (Error: %d)\n", status);
        ret = -1;
    }
    return ret;
}

void ed25519_sign(
    uint8_t *signature,
    const uint8_t *secret_key,
    const uint8_t *message,
    size_t message_len
) {
    psa_status_t status;
    int ret;

    // Import the key.
    psa_key_attributes_t key_attributes = PSA_KEY_ATTRIBUTES_INIT;

    psa_set_key_usage_flags(&key_attributes, PSA_KEY_USAGE_SIGN_MESSAGE);
    psa_set_key_lifetime(&key_attributes, PSA_KEY_LIFETIME_VOLATILE);
    psa_set_key_algorithm(&key_attributes, PSA_ALG_PURE_EDDSA);
    psa_set_key_type(&key_attributes, PSA_KEY_TYPE_ECC_KEY_PAIR(PSA_ECC_FAMILY_TWISTED_EDWARDS));
    psa_set_key_bits(&key_attributes, 255); // Ed25519, see https://armmbed.github.io/mbed-crypto/html/api/keys/types.html#c.PSA_ECC_FAMILY_TWISTED_EDWARDS

    psa_key_handle_t key_handle;

    // Even though we set the key_type to a KEY_PAIR, we only need to import the secret key, as the library will derive the public key itself.
    status = psa_import_key(&key_attributes, secret_key, 32, &key_handle);
    if (status != PSA_SUCCESS) {
        printk("psa_import_key failed! (Error: %d)\n", status);
        ret = -1;
        goto out;
    }

    size_t signature_length;
    status = psa_sign_message(
        key_handle,
        PSA_ALG_PURE_EDDSA,
        message,
        message_len,
        signature,
        64,
        &signature_length
    );

    if (status != PSA_SUCCESS) {
        printk("psa_sign_message failed! (Error: %d)\n", status);
        ret = -1;
        goto out;
    }

    ret = 0;
out:
    psa_reset_key_attributes(&key_attributes);
    status = psa_destroy_key(key_handle);
    if (status != PSA_SUCCESS) {
        printk("psa_destroy_key failed! (Error: %d)\n", status);
        ret = -1;
    }
    assert(ret == 0);
}

int ed25519_verify(
    const uint8_t *signature,
    const uint8_t *public_key,
    const uint8_t *message,
    size_t message_len
) {
    psa_status_t status;
    int ret;

    // Import the key.
    psa_key_attributes_t key_attributes = PSA_KEY_ATTRIBUTES_INIT;

    psa_set_key_usage_flags(&key_attributes, PSA_KEY_USAGE_VERIFY_MESSAGE);
    psa_set_key_lifetime(&key_attributes, PSA_KEY_LIFETIME_VOLATILE);
    psa_set_key_algorithm(&key_attributes, PSA_ALG_PURE_EDDSA);
    psa_set_key_type(&key_attributes, PSA_KEY_TYPE_ECC_PUBLIC_KEY(PSA_ECC_FAMILY_TWISTED_EDWARDS));
    psa_set_key_bits(&key_attributes, 255); // Ed25519, see https://armmbed.github.io/mbed-crypto/html/api/keys/types.html#c.PSA_ECC_FAMILY_TWISTED_EDWARDS

    psa_key_handle_t key_handle;

    status = psa_import_key(&key_attributes, public_key, 32, &key_handle);
    if (status != PSA_SUCCESS) {
        printk("psa_import_key failed! (Error: %d)\n", status);
        ret = -1;
        goto out;
    }

    status = psa_verify_message(
        key_handle,
        PSA_ALG_PURE_EDDSA,
        message,
        message_len,
        signature,
        64
    );

    if (status != PSA_SUCCESS) {
        printk("psa_verify_message failed! (Error: %d)\n", status);
        ret = -1;
        goto out;

    }
    ret = 0;
out:
    psa_reset_key_attributes(&key_attributes);
    status = psa_destroy_key(key_handle);
    if (status != PSA_SUCCESS) {
        printk("psa_destroy_key failed! (Error: %d)\n", status);
        ret = -1;
    }
    return ret;
}

int init_hw_crypto() {
    if (psa_crypto_init() != PSA_SUCCESS) {
        return -1;
    }
    fido_sha256 = &sha256;
    fido_sha512 = &sha512;
    fido_aes_gcm_encrypt = &aes_gcm_encrypt;
    fido_aes_gcm_decrypt = &aes_gcm_decrypt;
    fido_ed25519_sign = &ed25519_sign;
    fido_ed25519_verify = &ed25519_verify;
    return 0;
}

#else
int init_hw_crypto() {
    return 0;
}
#endif
```
