## examples/esp32/components/hw_crypto/Kconfig.projbuild
```kconfig
config USE_HW_CRYPTO
	bool "Use hardware acceleration for cryptography and hashing"
	default n
	help
		Decides whether FIDO operations will use hardware acceleration for cryptography and hashing (if possible)
```

## examples/esp32/sdkconfig.defaults
```kconfig
# Increase stack size to not make it crash
CONFIG_ESP_MAIN_TASK_STACK_SIZE=10240

# Set target to ESP32-C3
CONFIG_IDF_TARGET="esp32c3"
CONFIG_IDF_TARGET_ESP32C3=y

# Enable HW support for crypto and hashing
CONFIG_USE_HW_CRYPTO=y
CONFIG_MBEDTLS_HARDWARE_AES=y
CONFIG_MBEDTLS_HARDWARE_GCM=y
CONFIG_MBEDTLS_HARDWARE_SHA=y
```

## examples/measurements/esp32/main/Kconfig.projbuild
```kconfig
config MEASURE_ALGORITHM
    string "Algorithm to measure (aes_gcm, ed25519, inflate, sha256, sha512)"
	default n
	help
		Decides which of the algorithms aes_gcm, ed25519, inflate, sha256, sha512 should be measured.

config LOG_CYCLE_COUNT
    bool "Log the amount of CPU cycles it took to Serial"
	default n
	help
		Decides, whether the amount of CPU cycles the cryptographic/hash operation took should be measured and printed to Serial out.

config USE_HW_CRYPTO
	bool "Use hardware acceleration for cryptography and hashing"
	default n
	help
		Decides whether FIDO operations will use hardware acceleration for cryptography and hashing (if possible)
```

## examples/measurements/esp32/sdkconfig.defaults
```kconfig
# Increase stack size to not make it crash
CONFIG_ESP_MAIN_TASK_STACK_SIZE=10240

# Set target to ESP32-C3
CONFIG_IDF_TARGET="esp32c3"
CONFIG_IDF_TARGET_ESP32C3=y

# Disable interrupt watchdog for second loop
CONFIG_ESP_INT_WDT=n

# Algorithm to measure
CONFIG_MEASURE_ALGORITHM="ed25519"
```
